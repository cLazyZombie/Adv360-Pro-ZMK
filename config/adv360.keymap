#include <behaviors.dtsi>
#include <dt-bindings/zmk/keys.h>
#include <dt-bindings/zmk/bt.h>
#include <dt-bindings/zmk/rgb.h>
#include <dt-bindings/zmk/stp.h>
#include <dt-bindings/zmk/backlight.h>
#include <dt-bindings/zmk/pointing.h>

/* referenced from https://github.com/mierak/Adv360-Pro-ZMK */
#include "preprocessor_macros.dtsi"

#define DEFAULT 0
#define DEFAULT_MAP \
/*╭────────────┬────────────┬────────────┬────────────┬────────────┬────────────┬────────────╮                                        ╭────────────┬────────────┬────────────┬────────────┬────────────┬────────────┬────────────╮*/\
/* &ht F11 EQUAL  &ht F1 N1    &ht F2 N2    &ht F3 N3    &ht F4 N4    &ht F5 N5     &mo MOD                                                &mo MOD    &ht F6 N6    &ht F7 N7    &ht F8 N8    &ht F9 N9    &ht F10 N0  &ht F12 MINUS\ */\
    kp(EQUAL)      kp(N1)       kp(N2)       kp(N3)       kp(N4)       kp(N5)       &mo MOD                                               &mo MOD      kp(N6)       kp(N7)       kp(N8)       kp(N9)       kp(N0)     kp(MINUS)\
/*├────────────┼────────────┼────────────┼────────────┼────────────┼────────────┼────────────┤                                        ├────────────┼────────────┼────────────┼────────────┼────────────┼────────────┼────────────┤*/\
    kp(TAB)        kp(Q)        kp(W)        kp(E)        kp(R)        kp(T)         NONE                                                  NONE        kp(Y)        kp(U)        kp(I)        kp(O)        kp(P)       kp(BSLH)\
/*├────────────┼────────────┼────────────┼────────────┼────────────┼────────────┼────────────┼─────────┬─────────╮╭─────────┬─────────┼────────────┼────────────┼────────────┼────────────┼────────────┼────────────┼────────────┤*/\
  &mt LCTRL ESC    kp(A)        kp(S)        kp(D)        kp(F)        kp(G)         NONE     kp(LALT)  kp(LCTRL)  kp(RCTRL) kp(RALT)      NONE        kp(H)        kp(J)        kp(K)        kp(L)       kp(SEMI)     kp(SQT)\
/*├────────────┼────────────┼────────────┼────────────┼────────────┼────────────┼────────────┼─────────┼─────────┤├─────────┼─────────┼────────────┼────────────┼────────────┼────────────┼────────────┼────────────┼────────────┤*/\
    kp(LSHIFT)     kp(Z)        kp(X)        kp(C)        kp(V)        kp(B)                            kp(INS)    kp(PSCRN)                           kp(N)        kp(M)       kp(COMMA)     kp(DOT)     kp(FSLH)    &rshift_capsword\
/*├────────────┼────────────┼────────────┼────────────┼────────────┼────────────┼────────────┼─────────┼─────────┤├─────────┼─────────┼────────────┼────────────┼────────────┼────────────┼────────────┼────────────┼────────────┤*/\
    &mo SP        kp(GRAVE)     kp(CAPS)     kp(LEFT)     kp(RIGHT)                 kp(BSPC)   &mo SP   kp(LGUI)   kp(RGUI)  kp(ENTER)    kp(SPACE)                 kp(DOWN)     kp(UP)        &br_esc      kp(RBKT)     &mo SP\
/*╰────────────┴────────────┴────────────┴────────────┴────────────┴────────────┴────────────┴─────────┴─────────╯╰─────────┴─────────┴────────────┴────────────┴────────────┴────────────┴────────────┴────────────┴────────────╯*/\

#define KEYPAD 1
#define KEYPAD_MAP \
/*╭────────────┬────────────┬────────────┬────────────┬────────────┬────────────┬────────────╮                                        ╭────────────┬────────────┬────────────┬────────────┬────────────┬────────────┬────────────╮*/\
       ____         ____         ____         ____         ____         ____         ____                                                 ____          ____      kp(KP_NUM)  kp(KP_EQUAL) kp(KP_DIVIDE) kp(KP_MULTIPLY) kp(KP_MINUS)\
/*├────────────┼────────────┼────────────┼────────────┼────────────┼────────────┼────────────┤                                        ├────────────┼────────────┼────────────┼────────────┼────────────┼────────────┼────────────┤*/\
       ____         ____         ____         ____         ____         ____         ____                                                 ____          ____       kp(KP_N7)    kp(KP_N8)   kp(KP_N9)   kp(KP_MINUS)    ____\
/*├────────────┼────────────┼────────────┼────────────┼────────────┼────────────┼────────────┼─────────┬─────────╮╭─────────┬─────────┼────────────┼────────────┼────────────┼────────────┼────────────┼────────────┼────────────┤*/\
       ____         ____         ____         ____         ____         ____         ____       ____      ____       ____      ____       ____          ____       kp(KP_N4)    kp(KP_N5)   kp(KP_N6)   kp(KP_PLUS)     ____\
/*├────────────┼────────────┼────────────┼────────────┼────────────┼────────────┼────────────┼─────────┼─────────┤├─────────┼─────────┼────────────┼────────────┼────────────┼────────────┼────────────┼────────────┼────────────┤*/\
       ____         ____         ____         ____         ____         ____                              ____       ____                               ____       kp(KP_N1)    kp(KP_N2)   kp(KP_N3)   kp(KP_ENTER)    ____\
/*├────────────┼────────────┼────────────┼────────────┼────────────┼────────────┼────────────┼─────────┼─────────┤├─────────┼─────────┼────────────┼────────────┼────────────┼────────────┼────────────┼────────────┼────────────┤*/\
       ____         ____         ____         ____         ____                      ____       ____      ____       ____      ____       ____                     kp(KP_N0)    kp(UP)      kp(DOWN)    kp(KP_DOT)      ____\
/*╰────────────┴────────────┴────────────┴────────────┴────────────┴────────────┴────────────┴─────────┴─────────╯╰─────────┴─────────┴────────────┴────────────┴────────────┴────────────┴────────────┴────────────┴────────────╯*/\

#define FN 2
#define FN_MAP \
/*╭────────────┬────────────┬────────────┬────────────┬────────────┬────────────┬────────────╮                                        ╭────────────┬────────────┬────────────┬────────────┬────────────┬────────────┬────────────╮*/\
     kp(F11)      kp(F1)         kp(F2)      kp(F3)       kp(F4)       kp(F5)        ____                                                 ____        kp(F6)       kp(F7)        kp(F8)       kp(F9)      kp(F10)      kp(F12)\
/*├────────────┼────────────┼────────────┼────────────┼────────────┼────────────┼────────────┤                                        ├────────────┼────────────┼────────────┼────────────┼────────────┼────────────┼────────────┤*/\
       ____         ____         ____         ____         ____         ____         ____                                                 ____          ____       kp(LBKT)      kp(RBKT)     kp(LBRC)    kp(RBRC)      ____\
/*├────────────┼────────────┼────────────┼────────────┼────────────┼────────────┼────────────┼─────────┬─────────╮╭─────────┬─────────┼────────────┼────────────┼────────────┼────────────┼────────────┼────────────┼────────────┤*/\
       ____         ____         ____         ____         ____         ____         ____       ____      ____       ____      ____       ____        kp(LEFT)     kp(DOWN)     kp(UP)       kp(RIGHT)    kp(TILDE)   kp(GRAVE)\
/*├────────────┼────────────┼────────────┼────────────┼────────────┼────────────┼────────────┼─────────┼─────────┤├─────────┼─────────┼────────────┼────────────┼────────────┼────────────┼────────────┼────────────┼────────────┤*/\
       ____         ____         ____         ____         ____         ____                              ____       ____                               ____         ____         ____         ____         ____        ____\
/*├────────────┼────────────┼────────────┼────────────┼────────────┼────────────┼────────────┼─────────┼─────────┤├─────────┼─────────┼────────────┼────────────┼────────────┼────────────┼────────────┼────────────┼────────────┤*/\
       ____         ____         ____         ____         ____                      ____       ____      ____       ____      ____       ____                       ____         ____         ____         ____        ____\
/*╰────────────┴────────────┴────────────┴────────────┴────────────┴────────────┴────────────┴─────────┴─────────╯╰─────────┴─────────┴────────────┴────────────┴────────────┴────────────┴────────────┴────────────┴────────────╯*/\

#define MOD 3
#define MOD_MAP \
/*╭────────────┬────────────┬────────────┬────────────┬────────────┬────────────┬────────────╮                                        ╭────────────┬────────────┬────────────┬────────────┬────────────┬────────────┬────────────╮*/\
       ____     &bt BT_SEL 0 &bt BT_SEL 1 &bt BT_SEL 2 &bt BT_SEL 3 &bt BT_SEL 4     ____                                                 ____          ____         ____         ____         ____         ____        ____\
/*├────────────┼────────────┼────────────┼────────────┼────────────┼────────────┼────────────┤                                        ├────────────┼────────────┼────────────┼────────────┼────────────┼────────────┼────────────┤*/\
       ____         ____         ____         ____         ____         ____     &bootloader                                            &bootloader      ____        ____         ____         ____         ____        ____\
/*├────────────┼────────────┼────────────┼────────────┼────────────┼────────────┼────────────┼─────────┬─────────╮╭─────────┬─────────┼────────────┼────────────┼────────────┼────────────┼────────────┼────────────┼────────────┤*/\
       ____         ____         ____         ____         ____         ____         ____       ____   &bt BT_CLR &bt BT_CLR   ____  &rgb_ug RGB_MEFS_CMD 5  ____    ____         ____         ____         ____        ____\
/*├────────────┼────────────┼────────────┼────────────┼────────────┼────────────┼────────────┼─────────┼─────────┤├─────────┼─────────┼────────────┼────────────┼────────────┼────────────┼────────────┼────────────┼────────────┤*/\
       ____         ____         ____         ____         ____         ____                              ____       ____                               ____         ____         ____         ____         ____        ____\
/*├────────────┼────────────┼────────────┼────────────┼────────────┼────────────┼────────────┼─────────┼─────────┤├─────────┼─────────┼────────────┼────────────┼────────────┼────────────┼────────────┼────────────┼────────────┤*/\
       ____         ____         ____         ____         ____                      ____       ____      ____       ____      ____       ____                  &bl BL_TOG   &rgb_ug RGB_TOG &bl BL_INC  &bl BL_DEC     ____\
/*╰────────────┴────────────┴────────────┴────────────┴────────────┴────────────┴────────────┴─────────┴─────────╯╰─────────┴─────────┴────────────┴────────────┴────────────┴────────────┴────────────┴────────────┴────────────╯*/\

#define SP 4
#define SP_MAP \
/*╭────────────┬────────────┬────────────┬────────────┬────────────┬────────────┬────────────╮                                        ╭────────────┬────────────┬────────────┬────────────┬────────────┬────────────┬────────────╮*/\
/*     ____         ____         ____         ____         ____         ____         ____                                                 ____          ____         ____         ____         ____         ____         ____*/\
     kp(F11)      kp(F1)         kp(F2)      kp(F3)       kp(F4)       kp(F5)        ____                                                 ____        kp(F6)       kp(F7)        kp(F8)       kp(F9)      kp(F10)      kp(F12)\
/*   kp(PLUS)     kp(EXCL)      kp(AT)      kp(HASH)    kp(DOLLAR)   kp(PERCENT)     ____                                                 ____        kp(CARET)    kp(AMPS)      kp(STAR)     kp(LPAR)    kp(RPAR)     kp(UNDER)*/\
/*├────────────┼────────────┼────────────┼────────────┼────────────┼────────────┼────────────┤                                        ├────────────┼────────────┼────────────┼────────────┼────────────┼────────────┼────────────┤*/\
       ____         ____         ____         ____         ____         ____         ____                                                 ____        kp(GRAVE)    kp(LBKT)    kp(RBKT)      kp(LBRC)  kp(PAUSE_BREAK)  ____\
/*├────────────┼────────────┼────────────┼────────────┼────────────┼────────────┼────────────┼─────────┬─────────╮╭─────────┬─────────┼────────────┼────────────┼────────────┼────────────┼────────────┼────────────┼────────────┤*/\
       ____         ____         ____         ____         ____         ____         ____       ____      ____       ____      ____       ____        kp(LEFT)     kp(DOWN)     kp(UP)       kp(RIGHT)      ____        ____\
/*├────────────┼────────────┼────────────┼────────────┼────────────┼────────────┼────────────┼─────────┼─────────┤├─────────┼─────────┼────────────┼────────────┼────────────┼────────────┼────────────┼────────────┼────────────┤*/\
       ____         ____         ____         ____         ____         ____                              ____       ____                             kp(HOME)     kp(PG_DN)    kp(PG_UP)    kp(END)        ____        ____\
/*├────────────┼────────────┼────────────┼────────────┼────────────┼────────────┼────────────┼─────────┼─────────┤├─────────┼─────────┼────────────┼────────────┼────────────┼────────────┼────────────┼────────────┼────────────┤*/\
       ____         ____         ____        kp(HOME)    kp(END)                    kp(DEL)     ____      ____       ____      ____       ____                     kp(PG_DN)    kp(PG_UP)      ____         ____        ____\
/*╰────────────┴────────────┴────────────┴────────────┴────────────┴────────────┴────────────┴─────────┴─────────╯╰─────────┴─────────┴────────────┴────────────┴────────────┴────────────┴────────────┴────────────┴────────────╯*/\

#define ACT 5
#define ACT_MAP \
/*╭────────────┬────────────┬────────────┬────────────┬────────────┬────────────┬────────────╮                                        ╭────────────┬────────────┬────────────┬────────────┬────────────┬────────────┬────────────╮*/\
     kp(F11)      kp(F1)         kp(F2)      kp(F3)       kp(F4)       kp(F5)        ____                                                 ____        kp(F6)       kp(F7)        kp(F8)       kp(F9)      kp(F10)      kp(F12)\
/*├────────────┼────────────┼────────────┼────────────┼────────────┼────────────┼────────────┤                                        ├────────────┼────────────┼────────────┼────────────┼────────────┼────────────┼────────────┤*/\
       ____         ____         ____         ____         ____        ____          ____                                                 ____         ____       kp(PG_DN)     kp(PG_UP)      ____         ____      kp(BACKSPACE)\
/*├────────────┼────────────┼────────────┼────────────┼────────────┼────────────┼────────────┼─────────┬─────────╮╭─────────┬─────────┼────────────┼────────────┼────────────┼────────────┼────────────┼────────────┼────────────┤*/\
       ____         ____         ____         ____         ____         ____         ____       ____      ____       ____      ____       ____        kp(LEFT)     kp(DOWN)     kp(UP)       kp(RIGHT)      ____       kp(ENTER)\
/*├────────────┼────────────┼────────────┼────────────┼────────────┼────────────┼────────────┼─────────┼─────────┤├─────────┼─────────┼────────────┼────────────┼────────────┼────────────┼────────────┼────────────┼────────────┤*/\
       ____         ____         ____         ____         ____         ____                              ____       ____                               ____       kp(HOME)     kp(END)        ____         ____        ____\
/*├────────────┼────────────┼────────────┼────────────┼────────────┼────────────┼────────────┼─────────┼─────────┤├─────────┼─────────┼────────────┼────────────┼────────────┼────────────┼────────────┼────────────┼────────────┤*/\
       ____         ____         ____         ____         ____                      ____       ____      ____       ____      ____       ____                       ____         ____         ____         ____        ____\
/*╰────────────┴────────────┴────────────┴────────────┴────────────┴────────────┴────────────┴─────────┴─────────╯╰─────────┴─────────┴────────────┴────────────┴────────────┴────────────┴────────────┴────────────┴────────────╯*/\

/{
  behaviors {
    #include "macros.dtsi"
    #include "cust_behaviors.dtsi"
  };

  combos {
    compatible = "zmk,combos";
    #include "combo.dtsi"
  };

  keymap {
    compatible = "zmk,keymap";
    LAYER(DEFAULT)
    LAYER(KEYPAD)
    LAYER(FN)
    LAYER(MOD)
    LAYER(SP)
    LAYER(ACT)
  };
};
